## conf/machine/include/gcp.inc
```bitbake
MACHINEOVERRIDES =. "gcp:"

# gcp tdx depends on kvm and virtio
KERNEL_FEATURES:append:pn-linux-yocto-tiny = " gcp.scc cfg/virtio.scc cfg/paravirt_kvm.scc"
KERNEL_FEATURES:append:pn-linux-yocto = " gcp.scc cfg/virtio.scc cfg/paravirt_kvm.scc"
KERNEL_FEATURES:append:pn-linux-yocto-rt = " gcp.scc cfg/virtio.scc cfg/paravirt_kvm.scc"

# gcp is not compatible with udhcpc, needs dhcpcd
MACHINE_ESSENTIAL_EXTRA_RDEPENDS:append = " dhcpcd"


# doesnt work, no idea why
# IMAGE_FSTYPES:append = " wic.tar.gz"
```

## conf/machine/include/hyperv.inc
```bitbake
MACHINEOVERRIDES =. "hyperv:"

# Provide the tdx guest driver kernel module for all images
KERNEL_FEATURES:append:pn-linux-yocto-tiny = " hyperv.scc features/tpm/tpm-2.0.scc features/tpm/tpm-2.0-crb.scc"
KERNEL_FEATURES:append:pn-linux-yocto = " hyperv.scc features/tpm/tpm-2.0.scc features/tpm/tpm-2.0-crb.scc"
KERNEL_FEATURES:append:pn-linux-yocto-rt = " hyperv.scc features/tpm/tpm-2.0.scc features/tpm/tpm-2.0-crb.scc"


MACHINE_FEATURES:append = " tpm2"

# doesnt work, no idea why
# IMAGE_FSTYPES:append:core-image-minimal = " wic.vhd"
```

## conf/machine/include/qemu-x86.inc
```bitbake
KERNEL_FEATURES:append:pn-linux-yocto-tiny = " cfg/virtio.scc cfg/paravirt_kvm.scc"
KERNEL_FEATURES:append:pn-linux-yocto = " cfg/virtio.scc cfg/paravirt_kvm.scc"
KERNEL_FEATURES:append:pn-linux-yocto-rt = " cfg/virtio.scc cfg/paravirt_kvm.scc"

# doesnt work, no idea why
# IMAGE_FSTYPES:append:core-image-minimal = " wic.qcow2"
```

## conf/machine/include/sev-snp-guest.inc
```bitbake
require conf/machine/include/x86.inc

MACHINEOVERRIDES =. "sev-snp-guest:"

# Provide the tdx guest driver kernel module for all images
KERNEL_FEATURES:append:pn-linux-yocto-tiny = " sev-snp-guest.scc"
KERNEL_FEATURES:append:pn-linux-yocto = " sev-snp-guest.scc"
KERNEL_FEATURES:append:pn-linux-yocto-rt = " sev-snp-guest.scc"
```

## conf/machine/include/tdx-guest.inc
```bitbake
require conf/machine/include/x86.inc

MACHINEOVERRIDES =. "tdx-guest:"

# Provide the tdx guest driver kernel module for all images
KERNEL_FEATURES:append:pn-linux-yocto-tiny = " tdx-guest.scc"
KERNEL_FEATURES:append:pn-linux-yocto = " tdx-guest.scc"
KERNEL_FEATURES:append:pn-linux-yocto-rt = " tdx-guest.scc"
```

## conf/machine/include/x86.inc
```bitbake
DEFAULTTUNE ?= "x86-64-v3"

require conf/machine/include/x86/tune-x86-64-v3.inc

KERNEL_IMAGETYPE = "bzImage"
SERIAL_CONSOLES ?= "115200;ttyS0 115200;ttyS1"

MACHINE_FEATURES:append = "x86 pci"

do_image_wic[depends] += "syslinux:do_populate_sysroot syslinux-native:do_populate_sysroot mtools-native:do_populate_sysroot dosfstools-native:do_populate_sysroot"

# For runqemu
IMAGE_CLASSES += "qemuboot"

QB_CPU:x86-64 ?= "-cpu IvyBridge -machine q35,i8042=off"
QB_CPU_KVM:x86-64 ?= "-cpu IvyBridge -machine q35,i8042=off"

QB_SYSTEM_NAME = "qemu-system-x86_64"
```

## conf/machine/sev-snp-azure.conf
```bitbake
#@TYPE: Machine
#@NAME: Azure x86-64 SEV-SNP enabled machine
#@DESCRIPTION: Machine configuration for running a SEV-SNP enabled x86-64 system on Azure

require conf/machine/include/sev-snp-guest.inc
require conf/machine/include/hyperv.inc
```

## conf/machine/tdx-azure.conf
```bitbake
#@TYPE: Machine
#@NAME: Azure x86-64 tdx enabled machine
#@DESCRIPTION: Machine configuration for running a TDX enabled x86-64 system on Azure

require conf/machine/include/tdx-guest.inc
require conf/machine/include/hyperv.inc
```

## conf/machine/tdx-gcp.conf
```bitbake
#@TYPE: Machine
#@NAME: GCP x86-64 tdx enabled machine
#@DESCRIPTION: Machine configuration for running a TDX enabled x86-64 system on GCP

require conf/machine/include/tdx-guest.inc
require conf/machine/include/gcp.inc
```

## conf/machine/tdx-qemu.conf
```bitbake
#@TYPE: Machine
#@NAME: QEMU x86-64 tdx enabled machine
#@DESCRIPTION: Machine configuration for running an x86-64 system on QEMU

require conf/machine/include/qemu-x86.inc
require conf/machine/include/tdx-guest.inc
```

## conf/machine/tdx.conf
```bitbake
#@TYPE: Machine
#@NAME: x86-64 tdx enabled machine
#@DESCRIPTION: Machine configuration for running a TDX enabled x86-64 system on Azure and Qemu, GCP pending

require conf/machine/include/tdx-guest.inc
require conf/machine/include/qemu-x86.inc
require conf/machine/include/hyperv.inc
require conf/machine/include/gcp.inc
```

## wic/core-image-minimal.tdx-gcp.wks
```
# short-description: Create an EFI disk image
# long-description: Creates a partitioned EFI disk image that the user
# can directly dd to boot media.

part /boot --source bootimg-efi --sourceparams="loader=grub-efi,initrd=${INITRAMFS_IMAGE}-${MACHINE}.${INITRAMFS_FSTYPES}" --ondisk sda --label boot --active --align 1024

bootloader --ptable gpt --timeout=0 --append="console=ttyS0,38400n8 scsi_mod.use_blk_mq=Y console=tty0 ramdisk_size=402653184"
```

## wic/mkefiinitrd.wks
```
# short-description: Create an EFI disk image
# long-description: Creates a partitioned EFI disk image that the user
# can directly dd to boot media.

part /boot --source bootimg-efi --sourceparams="loader=systemd-boot,create-unified-kernel-image=true,initrd=${INITRAMFS_IMAGE}-${MACHINE}.${INITRAMFS_FSTYPES}" --ondisk sda --label msdos --active --align 1024

bootloader --ptable gpt --timeout=0 --append="console=ttyS0,115200 console=tty0 ramdisk_size=402653184 systemd.unified_cgroup_hierarchy=1 systemd.log_level=debug systemd.log_target=console"
```
